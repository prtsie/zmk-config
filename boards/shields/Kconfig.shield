## boards/shields/Kconfig.shield
```kconfig
# Copyright (c) 2020 Pete Johanson
# SPDX-License-Identifier: MIT

config SHIELD_corne_tp_LEFT
    def_bool $(shields_list_contains,corne_tp_left)

config SHIELD_corne_tp_RIGHT
    def_bool $(shields_list_contains,corne_tp_right)
```

## config/west.yml
```yaml
manifest:
  defaults:
    revision: v0.3
  remotes:
    - name: zmkfirmware
      url-base: https://github.com/zmkfirmware
    - name: infused-kim
      url-base: https://github.com/infused-kim
  projects:
    # - name: zmk
    #   remote: zmkfirmware
    #   import: app/west.yml
    - name: zmk
      remote: infused-kim
      revision: pr-testing/mouse_ps2_module_base
      import: app/west.yml
  self:
    path: config
```
